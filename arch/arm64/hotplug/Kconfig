## arch/arm64/hotplug/Kconfig
```kconfig
config STATE_HELPER
        bool "State Helper"
	    depends on STATE_NOTIFIER

config ASMP
	bool "Multi-core automatic hotplug support"
	depends on SMP
	default n
	help
           Automatically hotplugs the multiple cpu cores on and off based on cpu load and suspend state.
```
